## board/renesas/renesas.its
```
/dts-v1/;

/ {
        description = "R-Car S4 FIT Image";
        #address-cells = <1>;

        images {
                kernel {
                        description = "Kernel";
                        data = /incbin/("Image");
                        type = "kernel";
                        arch = "arm64";
                        os = "linux";
                        compression = "none";
                        load = <0x48080000>;
                        entry = <0x48080000>;
                        hash {
                                algo = "sha1";
                        };
                };

                fdt-rc {
                        description = "DTB-RC";
                        data = /incbin/("r8a779f0-spider.dtb");
                        type = "flat_dt";
                        arch = "arm64";
                        compression = "none";
                        load = <0x48000000>;
                        entry = <0x48000000>;
                        hash {
                                algo = "sha1";
                        };
                };

                fdt-ep {
                        description = "DTB-EP";
                        data = /incbin/("r8a779f0-spider-ep.dtb");
                        type = "flat_dt";
                        arch = "arm64";
                        compression = "none";
                        load = <0x48000000>;
                        entry = <0x48000000>;
                        hash {
                                algo = "sha1";
                        };
                };

                initrd {
                        description = "Initrd";
                        data = /incbin/("rootfs.cpio.gz");
                        type = "ramdisk";
                        arch = "arm64";
                        os = "linux";
                        compression = "none";
                        load = <0x74000000>;
                        entry = <0x74000000>;
                        hash {
                                algo = "sha1";
                        };
                };
        };

        configurations {
                default = "RC";

                RC {
                        description = "RC device";
                        kernel = "kernel";
                        fdt = "fdt-rc";
                        ramdisk = "initrd";
                        hash {
                                algo = "sha1";
                        };
                };

                EP {
                        description = "EP device";
                        kernel = "kernel";
                        fdt = "fdt-ep";
                        ramdisk = "initrd";
                        hash {
                                algo = "sha1";
                        };
                };

        };

}; 
```

## configs/renesas_s4_defconfig
```kconfig
BR2_aarch64=y
BR2_cortex_a57=y
BR2_TOOLCHAIN_EXTERNAL=y
BR2_CCACHE=y
BR2_INIT_SYSTEMD=y
BR2_SYSTEM_BIN_SH_BASH=y
BR2_SYSTEM_DEFAULT_PATH="/bin:/sbin:/usr/bin:/usr/sbin"
BR2_ROOTFS_OVERLAY="board/renesas/rootfs_overlay"
BR2_ROOTFS_POST_IMAGE_SCRIPT="board/renesas/post-image.sh"
BR2_LINUX_KERNEL=y
BR2_LINUX_KERNEL_CUSTOM_GIT=y
BR2_LINUX_KERNEL_CUSTOM_REPO_URL="https://github.com/yhamamachi/linux-pcie-virtio-net"
BR2_LINUX_KERNEL_CUSTOM_REPO_VERSION="pcie-wip3"
BR2_LINUX_KERNEL_DEFCONFIG="renesas_pcie_virtio_net"
BR2_LINUX_KERNEL_DTS_SUPPORT=y
BR2_LINUX_KERNEL_INTREE_DTS_NAME="renesas/r8a779f0-spider renesas/r8a779f0-spider-ep"
BR2_PACKAGE_E2FSPROGS=y
BR2_PACKAGE_PCIUTILS=y
BR2_PACKAGE_RDMA_CORE=y
BR2_PACKAGE_LIBMNL=y
BR2_PACKAGE_LIBMNL_EXAMPLES=y
BR2_PACKAGE_LIBNL_TOOLS=y
BR2_PACKAGE_ETHTOOL=y
BR2_PACKAGE_IPERF3=y
BR2_PACKAGE_IPUTILS=y
BR2_PACKAGE_OPENSSH=y
# BR2_PACKAGE_OPENSSH_SERVER is not set
# BR2_PACKAGE_OPENSSH_KEY_UTILS is not set
# BR2_PACKAGE_OPENSSH_SANDBOX is not set
BR2_PACKAGE_TCPDUMP=y
BR2_PACKAGE_ZSH=y
BR2_PACKAGE_VIM=y
BR2_TARGET_ROOTFS_CPIO=y
BR2_TARGET_ROOTFS_CPIO_GZIP=y
BR2_TARGET_ROOTFS_CPIO_UIMAGE=y
BR2_PACKAGE_HOST_UBOOT_TOOLS_FIT_SUPPORT=y
BR2_PACKAGE_HOST_UBOOT_TOOLS_FIT_SIGNATURE_SUPPORT=y
```
